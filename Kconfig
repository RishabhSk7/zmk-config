## config/west.yml
```yaml
manifest:
  remotes:
    - name: zmkfirmware
      url-base: https://github.com/zmkfirmware

    - name: mctechnology17
      url-base: https://github.com/mctechnology17

  projects:
    - name: zmk
      remote: zmkfirmware
      revision: v0.3.0
      import: app/west.yml

    - name: zmk-nice-oled
      remote: mctechnology17
      revision: main

  self:
    path: config
    # See https://docs.zephyrproject.org/3.2.0/develop/west/manifest.html#projects
```
